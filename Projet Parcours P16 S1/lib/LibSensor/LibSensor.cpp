// ------------------------------------------------------------------------------------------------
/* BcGE Universite de Sherbrooke- usherbrooke.ca
COPYRIGHT (c) 2017-2024 BY P16-A24-UdeSherbrooke ALL RIGHTS RESERVED. NO PART OF
THIS PROGRAM OR PUBLICATION MAY BE REPRODUCED, TRANSMITTED, TRANSCRIBED, STORED IN A RETRIEVAL
SYSTEM, OR TRANSLATED INTO ANY LANGUAGE OR COMPUTER LANGUAGE IN ANY FORM OR BY ANY MEANS,
ELECTRONIC, MECHANICAL, MAGNETIC, OPTICAL, CHEMICAL, MANUAL, OR OTHERWISE, WITHOUT THE PRIOR
WRITTEN PERMISSION OF TGE DEPARTMENT.
*/
// ------------------------------------------------------------------------------------------------
/*!@file
   @brief
   @author Arthur Blanchard
   @version 1.0
*/
// ------------------------------------------------------------------------------------------------

#include "LibSensor.h"

// ================================================================================================
// ================================================================================================
//            PRIVATE DEFINE DECLARATION
// ================================================================================================
// ================================================================================================

// ================================================================================================
// ================================================================================================
//            PRIVATE MACRO DEFINITION
// ================================================================================================
// ================================================================================================

// ================================================================================================
// ================================================================================================
//            PRIVATE STRUCTURE DECLARATION
// ================================================================================================
// ================================================================================================

// ================================================================================================
// ================================================================================================
//            PRIVATE VARIABLE DECLARATION
// ================================================================================================
// ================================================================================================

// ================================================================================================
// ================================================================================================
//            PRIVATE FUNCTION DECLARATION
// ================================================================================================
// ================================================================================================

// ================================================================================================
// ================================================================================================
//            PUBLIC FUNCTION SECTION
// ================================================================================================
// ================================================================================================

// Fonction pour vérifier la présence d'un mur
int wallCheck() {
    int red = analogRead(PIN_RED); 
    int green = analogRead(PIN_GREEN);

    if (red < IR_ON && green < IR_ON) {
        return 1; // Mur détecté
    } else if (red > IR_OFF && green > IR_OFF) {
        return 0; // Pas de mur
    }
    return -1; // Erreur
}


int whistleCheck(){
    if(analogRead(PIN_5KHZ) - analogRead(PIN_AMBIENT) >= KHZ_5_ON)
    {
        #if SERIAL_DEBUG
        Serial.print("Sifflet entendu");
        #endif
        return 1; 
    }

    #if SERIAL_DEBUG
        Serial.print("Anal Read pin 5k: ");Serial.println(analogRead(PIN_5KHZ),DEC);
        Serial.print("Anal Read pin Amb: ");Serial.println(analogRead(PIN_AMBIENT),DEC);
    #endif

    return 0;
}


// ================================================================================================
// ================================================================================================
//            PRIVATE FUNCTION SECTION
// ================================================================================================
// ================================================================================================